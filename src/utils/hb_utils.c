#include "hb_utils.h"

#include "hw_board.h"
#include "hw_gpio.h"
#include "hw_pwm.h"
#include "hb_display.h"
#include "hb_storage.h"
#include <assert.h>
#include "hb_build_config.h"
#include "esp_sleep.h"
#include "driver/rtc_io.h"
#include "hb_pwr_node.h"

#include "freertos/FreeRTOS.h"
#include "freertos/task.h"

/*************************************************************************
*  Format conversion functions
*************************************************************************/

static uint8_t hex[] = "0123456789ABCDEF";

uint8_t hexchar2nibble (uint8_t c)
{
    return (c <= '9') ? (c - '0') : ((c | 0x20) - 'a' + 10);
}

uint8_t hex2byte_ (uint8_t* src_buf)
{
    return (hexchar2nibble(src_buf[0]) << 4) + hexchar2nibble(src_buf[1]);
}

void byte2hex (uint8_t byte, uint8_t* dst_buf)
{
    dst_buf[0] = hex[byte >> 4];
    dst_buf[1] = hex[byte & 0x0F];
}

void short2hex (uint8_t* src_buf, uint8_t* dst_buf)
{
    byte2hex(src_buf[0], &dst_buf[0]);
    byte2hex(src_buf[1], &dst_buf[2]);
}

void hex2short (uint8_t* src_buf, uint8_t* dst_buf)
{
    dst_buf[0] = hex2byte_(&src_buf[0]);
    dst_buf[1] = hex2byte_(&src_buf[2]);
}

void long2hex (uint8_t* src_buf, uint8_t* dst_buf)
{
    byte2hex(src_buf[0], &dst_buf[0]);
    byte2hex(src_buf[1], &dst_buf[2]);
    byte2hex(src_buf[2], &dst_buf[4]);
    byte2hex(src_buf[3], &dst_buf[6]);
}

void hex2long (uint8_t* src_buf, uint8_t* dst_buf)
{
    dst_buf[0] = hex2byte_(&src_buf[0]);
    dst_buf[1] = hex2byte_(&src_buf[2]);
    dst_buf[2] = hex2byte_(&src_buf[4]);
    dst_buf[3] = hex2byte_(&src_buf[6]);
}

void bin2hex (uint8_t* src_buf, uint8_t* dst_buf, uint32_t bin_data_len)
{
    uint32_t i;

    for (i = 0; i < bin_data_len; i++) {
        byte2hex(src_buf[i], &dst_buf[i * 2]);
    }
}

void hex2bin (uint8_t* src_buf, uint8_t* dst_buf, uint32_t hex_data_len)
{
    uint32_t i;

    for (i = 0; i < hex_data_len / 2; i++) {
        dst_buf[i] = hex2byte_(&src_buf[2 * i]);
    }
}

uint32_t is_hex_digit (uint8_t c)
{
    if (((c >= '0') && (c <= '9')) ||
        ((c >= 'A') && (c <= 'F')) ||
        ((c >= 'a') && (c <= 'f')))
    {
        return 1;
    }
    return 0;
}

void* int2ascii (int32_t i, void* dst_buf)
{
    char const digit[] = "0123456789";
    int shifter;
    char* p = dst_buf;

    if (i < 0)
    {
        *p++ = '-';
        i = -i;
    }

    shifter = i;

    do
    {
            // move to where representation ends
        ++p;
        shifter = shifter/10;
    } while (shifter);

    *p = '\0';

    do
    {
            // move back, inserting digits as u go
        *--p = digit[i % 10];
        i = i / 10;
    } while(i);

    return dst_buf;
}
/* =============================================================== */



/* ******************************************************************
 * CRC related functions
 * *****************************************************************/

uint16_t crc16_update(uint16_t crc, uint8_t data)
{
    int i;

    crc = crc ^ ((uint16_t)data << 8);

    for (i = 0; i < 8; i++)
    {
        if (crc & 0x8000) {
            crc = (crc << 1) ^ 0x8005;
        } else {
            crc <<= 1;
        }
    }

    return crc;
}

uint16_t crc16_update_bulk(uint16_t crc, uint8_t data[], int len)
{
    for (int i=0; i<len; i++) {
        crc = crc16_update(crc, data[i]);
    }
    return crc;
}

uint16_t crc16(const uint8_t* buf, uint32_t len)
{
    uint16_t res = 0;
    uint32_t i;

    for (i = 0; i < len; i++) {
        res = crc16_update(res, buf[i]);
    }
    return res;
}

uint16_t crc16_table(uint8_t *adr_buffer, uint32_t byte_cnt)
{
    static unsigned char auchCRCHi[]=
    {
        0x00,0xC1,0x81,0x40,0x01,0xC0,0x80,0x41,0x01,0xC0,0x80,0x41,0x00,0xC1,0x81,0x40,
        0x01,0xC0,0x80,0x41,0x00,0xC1,0x81,0x40,0x00,0xC1,0x81,0x40,0x01,0xC0,0x80,0x41,
        0x01,0xC0,0x80,0x41,0x00,0xC1,0x81,0x40,0x00,0xC1,0x81,0x40,0x01,0xC0,0x80,0x41,
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        0x00,0xC1,0x81,0x40,0x01,0xC0,0x80,0x41,0x01,0xC0,0x80,0x41,0x00,0xC1,0x81,0x40,
    };
    /*Table of CRC values for low–order byte*/
    static char auchCRCLo[]=
    {
        0x00,0xC0,0xC1,0x01,0xC3,0x03,0x02,0xC2,0xC6,0x06,0x07,0xC7,0x05,0xC5,0xC4,0x04,
        0xCC,0x0C,0x0D,0xCD,0x0F,0xCF,0xCE,0x0E,0x0A,0xCA,0xCB,0x0B,0xC9,0x09,0x08,0xC8,
        0xD8,0x18,0x19,0xD9,0x1B,0xDB,0xDA,0x1A,0x1E,0xDE,0xDF,0x1F,0xDD,0x1D,0x1C,0xDC,
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        0x44,0x84,0x85,0x45,0x87,0x47,0x46,0x86,0x82,0x42,0x43,0x83,0x41,0x81,0x80,0x40,
    };

    unsigned char uchCRCHi = 0xFF;
    unsigned char uchCRCLo = 0xFF;
    unsigned uIndex;

    /* CRC Generation Function */
    while( byte_cnt--) /* pass through message buffer */
    {
        uIndex = uchCRCHi ^ *adr_buffer++; /* calculate the CRC */
        uchCRCHi = uchCRCLo ^ auchCRCHi[uIndex];
        uchCRCLo = auchCRCLo[uIndex];
    }
    return (uchCRCHi << 8 | uchCRCLo);
}

void crc32(uint32_t* _crc, const uint8_t* _data, uint32_t _len)
{
    static const uint32_t s_crc32_table[256] = {
        0x00000000UL, 0x77073096UL, 0xee0e612cUL, 0x990951baUL, 0x076dc419UL,
        0x706af48fUL, 0xe963a535UL, 0x9e6495a3UL, 0x0edb8832UL, 0x79dcb8a4UL,
        0xe0d5e91eUL, 0x97d2d988UL, 0x09b64c2bUL, 0x7eb17cbdUL, 0xe7b82d07UL,
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        0x5d681b02UL, 0x2a6f2b94UL, 0xb40bbe37UL, 0xc30c8ea1UL, 0x5a05df1bUL,
        0x2d02ef8dL
    };

    assert(_crc);
    assert(_data);

#define CRC32_DO1(p) do { crc = s_crc32_table[(crc ^ (uint32_t)(*p++)) & 0xff] ^ (crc >> 8); } while (0)
#define CRC32_DO2(p) do { CRC32_DO1(p); CRC32_DO1(p); } while (0)
#define CRC32_DO4(p) do { CRC32_DO2(p); CRC32_DO2(p); } while (0)
#define CRC32_DO8(p) do { CRC32_DO4(p); CRC32_DO4(p); } while (0)

    uint32_t crc = *_crc;
    crc ^= 0xffffffffUL;

    while (_len >= 8)
    {
        CRC32_DO8(_data);
        _len -= 8;
    }

    if (_len)
        do
            CRC32_DO1(_data);
        while (--_len);
    *_crc = crc ^ 0xffffffffUL;

#undef CRC32_DO8
#undef CRC32_DO4
#undef CRC32_DO2
#undef CRC32_DO1
}
/* =============================================================== */
#ifdef HB_TRACE

char* addr2str(char* _addr)
{
  static char buf[32];
  const uint8_t *addr = (uint8_t*)_addr;
  sprintf(buf, "%02x:%02x:%02x:%02x:%02x:%02x", addr[5], addr[4], addr[3],
    addr[2], addr[1], addr[0]);
  return buf;
}

/* ******************************************************************
 * Print buffer functions
 * *****************************************************************/

void print_buf_hex(uint8_t* buf, uint32_t len, uint32_t add_new_line)
{
    uint32_t i;
    HBPRINT("print_buf(%lu): ", len);
    for (i = 0; i < len; i++) {
        //printf("%02X ", buf[i]);
        HBPRINT("%02X", (char)buf[i]);
    }

    if (add_new_line != 0) {
        HBPRINT("\r\n");
    }
}

void print_buf(uint8_t* buf, uint32_t len, uint32_t add_new_line)
{
    uint32_t i;

    for (i = 0; i < len; i++) {
        HBPRINT("%02X", buf[i]);
    }

    if (add_new_line != 0) {
        HBPRINT("\n\n");
    }
}

void print_vartype32(void* pval)
{
#if 0
    uint8_t* p_int = pval;
    uint32_t i;

    for (i = 0; i < 4; i++)
    {
		HBPRINT("%02X", p_int[3 - i]);
    }
#endif
}

void print_chars(uint8_t* buf, uint32_t len)
{
    uint32_t i;

    for (i = 0; i < len; i++) {
        HBPRINT("%c", buf[i]);
    }
    HBPRINT("\n");
}

void print_rx_buff(uint8_t* buf, uint32_t len)
{
    HBPRINT("    RX buffer [%2ld bytes]: ", len);
    print_chars(buf, len);
    HBPRINT("\n");
}

#endif // HB_TRACE
/* =============================================================== */

// standby mode
void system_standby()
{
	db_params.current_mode = 2;

	hw_pwm_value_set(0, 0); //125
	hw_pwm_deinit();
	dev_params.light = 0;

	// ====================================
	// == COMMAND SAM4 FOR STANDBY ENTER ==
	// ====================================

	//vTaskDelay(((MCU_SLEEP_TIME_US/1000) + 200) / portTICK_PERIOD_MS);

	esp_sleep_enable_touchpad_wakeup();
	esp_light_sleep_start();

	// ==================================
	// == WAKEUP SAM4 FOR STANDBY EXIT ==
	// ==================================

	db_params.current_mode = 0;
}

// power off
void system_shutdown()
{
	db_params.current_mode = 3;

	hw_pwm_value_set(0, 0); //125
	hw_pwm_deinit();
	dev_params.light = 0;

	// ===============================
	// == COMMAND SAM4 FOR SHUTDOWN ==
	// ===============================

	//vTaskDelay(((MCU_SLEEP_TIME_US/1000) + 200) / portTICK_PERIOD_MS);

	esp_sleep_enable_touchpad_wakeup();
	esp_light_sleep_start();

	db_params.current_mode = 0;
}
